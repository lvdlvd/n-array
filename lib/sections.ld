/*
 * Generic section layout for [N]Array. Run-model-independent: the per-part
 * memory script (generated by narray) defines the MEMORY regions and binds the
 * region aliases TEXT / DATA / LOAD before INCLUDE-ing this file.
 *
 *   TEXT  where .isr_vector/.text/.rodata live (FLASH for ROM, SRAM for RAM)
 *   DATA  where .data/.bss run (SRAM)
 *   LOAD  where the .data initialiser image is stored (FLASH for ROM; for RAM
 *         LOAD == DATA, so LMA == VMA and the startup copy is a no-op)
 *
 * Provides _sidata/_sdata/_edata/_sbss/_ebss for narray_init_memory() in
 * lib/startup.h. The vector table (.isr_vector) is the application-owned array;
 * EXTERN keeps it even though nothing references it before VTOR is set.
 */

ENTRY(Reset_Handler)
EXTERN(__vectors)

SECTIONS
{
  .isr_vector : {
    . = ALIGN(4);
    KEEP(*(.isr_vector))
    . = ALIGN(4);
  } > TEXT

  .text : {
    . = ALIGN(4);
    _stext = .;                  /* code span, for the fault backtrace scanner */
    *(.text) *(.text.*)
    *(.rodata) *(.rodata.*)
    . = ALIGN(4);
    _etext = .;
  } > TEXT

  .data : {
    . = ALIGN(4);
    _sdata = .;
    *(.data) *(SORT_BY_ALIGNMENT(.data.*))
    . = ALIGN(4);
    _edata = .;
  } > DATA AT> LOAD
  _sidata = LOADADDR(.data);  /* .data source: flash for ROM, == _sdata for RAM */

  .bss : {
    . = ALIGN(4);
    _sbss = .;
    *(.bss) *(SORT_BY_ALIGNMENT(.bss.*)) *(COMMON)
    . = ALIGN(4);
    _ebss = .;
  } > DATA

  /* lib/fault.c crash record at the low end of CCRAM (NOLOAD: not zeroed at
     boot, survives reset). The stack grows down from _estack (top of CCRAM);
     _stack_limit leaves the record plus a guard gap below it. */
  .crashdump (NOLOAD) : {
    . = ALIGN(8);
    KEEP(*(.crashdump))
    . = ALIGN(8);
  } > CCMRAM
  _stack_limit = ORIGIN(CCMRAM) + SIZEOF(.crashdump) + 256; /* + guard gap */

  /DISCARD/ : {
    *(.ARM.exidx) *(.ARM.exidx.*) /* unwind tables: unused, and disturb .data init */
  }
}
